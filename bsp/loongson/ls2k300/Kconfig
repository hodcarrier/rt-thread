## bsp/loongson/ls2k300/Kconfig
```kconfig
# base on:
# bsp/loongson/ls2kdev/Kconfig
mainmenu "RT-Thread Configuration"

config BSP_DIR
    string
    option env="BSP_ROOT"
    default "."

config RTT_DIR
    string
    option env="RTT_ROOT"
    default "../../.."

# you can change the RTT_ROOT default "../../.." to your rtthread_root,
# example : default "F:/git_repositories/rt-thread"

config PKGS_DIR
    string
    option env="PKGS_ROOT"
    default "packages"

source "$RTT_DIR/Kconfig"
source "$RTT_DIR/libcpu/loongarch/common/Kconfig"
source "$PKGS_DIR/Kconfig"

config SOC_LS2K300
    bool
    select ARCH_LOONGARCH
    select RT_USING_CACHE
    select RT_USING_COMPONENTS_INIT
    select RT_USING_USER_MAIN
    select RT_USING_DEVICE
    default y

if RT_USING_SERIAL
config RT_USING_UART0
    bool "Using RT_USING_UART0"
    default y
endif
```
